## conf/layer.conf
```bitbake
# add conf and classes directory to BBPATH
BBPATH := "${BBPATH}:${LAYERDIR}"

# add the recipes to BBFILES
BBFILES := "${BBFILES} \
	${LAYERDIR}/*.bb \
	${LAYERDIR}/*.bbappend \
    "

BBFILE_COLLECTIONS += "victronenergy-rpi2"
BBFILE_PATTERN_victronenergy-rpi2 := "^${LAYERDIR}/"
BBFILE_PRIORITY_victronenergy-rpi2 = "30"
```
